## components/CameraManager/Kconfig.projbuild
```kconfig
menu "Camera sensor pinout configuration"

    orsource "$IDF_PATH/examples/common_components/env_caps/$IDF_TARGET/Kconfig.env_caps"

    config CAMERA_MODULE_NAME
        string "Camera module name"
        default "ESP32S3_XIAO_SENSE"
        help 
            Camera module name

    config PWDN_GPIO_NUM
        int "Power Down GPIO Number"
        default -1
        help
            Power Down GPIO number

    config RESET_GPIO_NUM
        int "Reset GPIO Number"
        default -1
        help
            Reset GPIO number

    config XCLK_GPIO_NUM
        int "External Clock (XCLK) GPIO Number"
        default 10
        help
            External Clock GPIO number (set to GPIO 4)

    config SIOD_GPIO_NUM
        int "Serial Data I/O (SIOD) GPIO Number"
        default 40
        help
            Serial Data I/O (SDA) GPIO number (set to GPIO 18)

    config SIOC_GPIO_NUM
        int "Serial Clock (SIOC) GPIO Number"
        default 39
        help
            Serial Clock (SCL) GPIO number (set to GPIO 23)

    config Y9_GPIO_NUM
        int "Y9 Data Bit GPIO Number"
        default 48
        help
            Y9 Data bit GPIO number (set to GPIO 36)

    config Y8_GPIO_NUM
        int "Y8 Data Bit GPIO Number"
        default 11
        help
            Y8 Data bit GPIO number (set to GPIO 37)

    config Y7_GPIO_NUM
        int "Y7 Data Bit GPIO Number"
        default 12
        help
            Y7 Data bit GPIO number (set to GPIO 38)

    config Y6_GPIO_NUM
        int "Y6 Data Bit GPIO Number"
        default 14
        help
            Y6 Data bit GPIO number (set to GPIO 39)

    config Y5_GPIO_NUM
        int "Y5 Data Bit GPIO Number"
        default 16
        help
            Y5 Data bit GPIO number (set to GPIO 14)

    config Y4_GPIO_NUM
        int "Y4 Data Bit GPIO Number"
        default 18
        help
            Y4 Data bit GPIO number (set to GPIO 19)

    config Y3_GPIO_NUM
        int "Y3 Data Bit GPIO Number"
        default 17
        help
            Y3 Data bit GPIO number (set to GPIO 13)

    config Y2_GPIO_NUM
        int "Y2 Data Bit GPIO Number"
        default 15
        help
            Y2 Data bit GPIO number (set to GPIO 34)

    config VSYNC_GPIO_NUM
        int "Vertical Sync (VSYNC) GPIO Number"
        default 38
        help
            Vertical Sync GPIO number (set to GPIO 5)

    config HREF_GPIO_NUM
        int "Horizontal Reference (HREF) GPIO Number"
        default 47
        help
            Horizontal Reference GPIO number (set to GPIO 27)

    config PCLK_GPIO_NUM
        int "Pixel Clock (PCLK) GPIO Number"
        default 13
        help
            Pixel Clock GPIO number (set to GPIO 25)

endmenu
```

## main/Kconfig.projbuild
```kconfig
menu "ENV_Caps"

    orsource "$IDF_PATH/examples/common_components/env_caps/$IDF_TARGET/Kconfig.env_caps"

endmenu

menu "OpenIris: General Configuration"

    config START_IN_UVC_MODE
        bool "Start in UVC Mode"
        default false
        help
            Enables UVC (wired) support in the firmware by default.
            To be used when a board is designed to be used primarily with wired headsets.
            When enabled, the default device streaming mode will be UVC unless overridden by a
            saved preference. When disabled, the default mode is AUTO.

    config GENERAL_INCLUDE_UVC_MODE
        bool "Wired mode"
        default false
        help
            Enables UVC (wired) support in the firmware. When enabled, the
            default device streaming mode will be UVC unless overridden by a
            saved preference. When disabled, the default mode is AUTO.

    config GENERAL_STARTUP_DELAY
        int "UVC delay (s)"
        default 30
        range 10 10000
        help
            Delay in seconds before the ESP reports itself as a UVC device.

    config GENERAL_ENABLE_WIRELESS
        bool "Enable wireless (WiFi/Bluetooth)"
        default y
        help
            When disabled, the firmware will not start WiFi or related services (mDNS/REST),
            and any Bluetooth memory (if present on the SoC) should be left released. This can
            reduce power consumption when operating solely in UVC mode or without networking.

endmenu

menu "OpenIris: Camera Configuration"

    config CAMERA_USB_XCLK_FREQ
        int "USB XCLK frequency (Hz)"
        default 10000000 # should be set in individual board config 
        range 1 24000000
        help
            USB XCLK frequency in Hz.

    config CAMERA_WIFI_XCLK_FREQ
        int "WIFI XCLK frequency (Hz)"
        default 16500000
        range 1 24000000
        help
            WIFI XCLK frequency in Hz.

endmenu

menu "OpenIris: WiFi Configuration"

    config WIFI_MDNS_HOSTNAME
        string "mDNS hostname"
        default "openiristracker"

    config WIFI_SSID
        string "WiFi network name (SSID)"
        default ""

    config WIFI_PASSWORD
        string "WiFi password"
        default ""

    config WIFI_AP_SSID
        string "Access Point WiFi network name (SSID)"
        default "EyeTrackVR"

    config WIFI_AP_PASSWORD
        string "Access Point WiFi password"
        default "12345678"

endmenu

menu "OpenIris: LED Configuration"

    config LED_DEBUG_GPIO
        int "Debug LED GPIO number"
        range ENV_GPIO_RANGE_MIN ENV_GPIO_OUT_RANGE_MAX
        default 8
        help
            GPIO number (IOxx) used to drive an onboard debug/status LED.
            Some GPIOs are reserved for other functions (e.g. flash) and cannot be used.

    config LED_EXTERNAL_GPIO
        int "GPIO pin controlling external LEDs"
        range ENV_GPIO_RANGE_MIN ENV_GPIO_OUT_RANGE_MAX
        default 1
        help
            GPIO number connected to the control line of the external IR LEDs.

    config LED_EXTERNAL_CONTROL
        bool "Board supports external IR LED control"
        default false
        help
            Enable this if your board can control external IR LEDs.

    config LED_EXTERNAL_PWM_FREQ
        int "External LED PWM frequency (Hz)"
        default 5000
        range 1 40000
        depends on LED_EXTERNAL_CONTROL
        help
            Frequency of the PWM signal driving the external IR LEDs.

    config LED_EXTERNAL_PWM_DUTY_CYCLE
        int "External LED PWM duty cycle (%)"
        default 50
        range 0 100
        depends on LED_EXTERNAL_CONTROL
        help
            Duty cycle of the PWM signal for external IR LEDs, in percent.
            0 means always off, 100 means always on.

endmenu

menu "OpenIris: Monitoring"

    config MONITORING_LED_CURRENT
        bool "Enable LED current monitoring"
        default y
        help
            Enable sampling LED current via ADC and report it over commands.

    config MONITORING_LED_ADC_GPIO
        int "ADC GPIO for LED current sense"
        depends on MONITORING_LED_CURRENT
        range 0 48
        default 3
        help
            GPIO connected to the current sense input (ADC1 on ESP32-S3: 1..10 supported).

    config MONITORING_LED_GAIN
        int "Analog front-end gain/divider"
        depends on MONITORING_LED_CURRENT
        range 1 1024
        default 11
        help
            Divider or amplifier gain between shunt and ADC. The measured mV are divided by this value.

    config MONITORING_LED_SHUNT_MILLIOHM
        int "Shunt resistance (milli-ohms)"
        depends on MONITORING_LED_CURRENT
        range 1 1000000
        default 22000
        help
            Shunt resistor value in milli-ohms. Current[mA] = 1000 * Vshunt[mV] / R[mΩ].

    config MONITORING_LED_SAMPLES
        int "Filter window size (samples)"
        depends on MONITORING_LED_CURRENT
        range 1 200
        default 10
        help
            Moving-average window length for voltage filtering.

    config MONITORING_LED_INTERVAL_MS
        int "Sampling interval (ms)"
        depends on MONITORING_LED_CURRENT
        range 10 60000
        default 500
        help
            Period between samples when background monitoring is active.

endmenu
```

## sdkconfig.defaults.esp32s3
```kconfig
CONFIG_BLINK_LED_GPIO=y
CONFIG_BLINK_GPIO=21

CONFIG_ESPTOOLPY_FLASHSIZE_8MB=y

CONFIG_CAMERA_MODULE_ESP_S3_EYE=y
CONFIG_ESP32S3_DEFAULT_CPU_FREQ_240=y
CONFIG_ESP32S3_SPIRAM_SUPPORT=y
CONFIG_SPIRAM_MODE_OCT=y
```
